## build/Kconfig/Kconfig.shield
```kconfig
osource "c:/Users/ivpi/mytestfolder/Check_signal/boards/shields/*/Kconfig.shield"
osource "C:/Users/ivpi/ncs/v1.8.0/nrf/boards/shields/*/Kconfig.shield"
```

## build_1/Kconfig/Kconfig.shield.defconfig
```kconfig
osource "c:/Users/ivpi/mytestfolder/Check_signal/boards/shields/*/Kconfig.defconfig"
osource "C:/Users/ivpi/ncs/v1.8.0/nrf/boards/shields/*/Kconfig.defconfig"
```
